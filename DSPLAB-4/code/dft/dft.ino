float x[]={-87.17307638,-109.5495333,11.00037444,163.4286511,199.1497693,123.5660003,56.25558579,11.87495703,-18.97729813,-42.98507139,-49.50432452,-44.95819516,-33.93206642,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-17.77934267
};
    float  WR[75][75]={0},WI[75][75]={0};
#define pi 3.1415926535897932384626433832795


void setup() {
  // put your setup code here, to run once:
  Serial.begin(9600);


}

void loop() {
  // put your main code here, to run repeatedly:

  // Moving average filter with number of samples as 'm'
  int xt[75];
  int m = 2;
  xt[0] = x[0];
  for(int i=1; i<m; i++){
    xt[i]= xt[i-1] + x[i];
  }
  for(int i=m; i<75; i++){
    xt[i] = 0;
    for(int j=0; j<m; j++){
      xt[i] += x[i-j];
    }
  }

  for(int i=0; i<75; i++){
    xt[i] = xt[i]/m;
  }
  
double xfr[75]={0},xfi[75]={0},mag[75]={0};
for(int i=0;i<75;i++)
     for(int j=0;j<75;j++)
        WR[i][j]=cos((2*pi*i*j)/75);


    for(int i=0;i<75;i++)
     for(int j=0;j<75;j++)
        WI[i][j]=sin((2*pi*i*j)/75);

  for(int i=0;i<75;i++)
  {
    for(int j=0;j<75;j++)
       xfr[i]+=xt[j]*WR[i][j];
  }


    for(int i=0;i<75;i++)
  {
    for(int j=0;j<75;j++)
       xfi[i]+=xt[j]*WI[i][j];
  }

 for(int i=0;i<75;i++)
   mag[i]=sqrt(xfr[i]*xfr[i]+xfi[i]*xfi[i]);

// for(int i=0;i<75;i++)
//   Serial.println(mag[i]);

 m = 0;
 int peak =0;
 for(int k=0;k<7;k++){
  if(m < mag[k]){
    m = mag[k];
    peak = k;
  }
 }
 Serial.println(peak*20);
}
